## conf/layer.conf
```bitbake
# We have a conf and classes directory, add to BBPATH
BBPATH .= ":${LAYERDIR}"

# We have recipes-* directories, add to BBFILES
BBFILES += "${LAYERDIR}/recipes-*/*.bb \
            ${LAYERDIR}/recipes-*/*.bbappend \
            ${LAYERDIR}/recipes-*/*/*.bb \
            ${LAYERDIR}/recipes-*/*/*.bbappend"

BBFILE_COLLECTIONS += "meta-agp01"
BBFILE_PATTERN_meta-agp01 = "^${LAYERDIR}/"
BBFILE_PRIORITY_meta-agp01 = "6"

LAYERDEPENDS_meta-agp01 = "core"
LAYERSERIES_COMPAT_meta-agp01 = "dunfell"
```

## conf/machine/sama5d3-agp01.conf
```bitbake
#@TYPE: Machine
#@Name: AGP01 (ATMEL SAMA5D3)
#@DESCRIPTION: Machine configuration for AGP01 DAQ system

require conf/machine/include/sama5d3.inc

MACHINE_FEATURES = "apm ext2 ext3 usbhost usbgadget"

KERNEL_DEVICETREE = " \
    at91-sama5d3-agp01.dtb \
    "
    
IMAGE_FSTYPES += " tar.gz wic"

do_image_wic[depends] += "u-boot-at91:do_deploy"
WKS_FILE = "sdimage-bootpart.wks"
IMAGE_BOOT_FILES = "BOOT.BIN u-boot.bin uboot.env sama5d3-agp01.itb"

# used by sysvinit_2
SERIAL_CONSOLES = "115200;ttyS1 115200;ttyS0"

UBOOT_MACHINE ?= "sama5d3_xplained_mmc_defconfig"
UBOOT_ENTRYPOINT = "0x20008000"
UBOOT_LOADADDRESS = "0x20008000"
UBOOT_ENV_SIZE = "0x4000"

AT91BOOTSTRAP_MACHINE = "sama5d3-agp01"

# Needed for FIT
MACHINE_ESSENTIAL_EXTRA_RDEPENDS = " dt-overlay-at91"

PREFERRED_VERSION_linux-mchp    = "5.10%"
```
